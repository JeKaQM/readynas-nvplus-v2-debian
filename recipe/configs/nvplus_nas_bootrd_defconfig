## recipe/configs/nvplus_nas_bootrd_defconfig
```kconfig
BR2_arm=y
BR2_arm926t=y
BR2_TOOLCHAIN_EXTERNAL=y
BR2_TOOLCHAIN_EXTERNAL_BOOTLIN=y
BR2_TOOLCHAIN_EXTERNAL_BOOTLIN_ARMV5_EABI_MUSL_STABLE=y
BR2_TARGET_GENERIC_HOSTNAME="nvplus-boot"
BR2_INIT_NONE=y
BR2_SYSTEM_DHCP=""
BR2_ROOTFS_OVERLAY="$(BR2_EXTERNAL_NVPLUS_NAS_PATH)/board/nvplus-nas/overlay-bootrd"
BR2_ROOTFS_POST_BUILD_SCRIPT="$(BR2_EXTERNAL_NVPLUS_NAS_PATH)/board/nvplus-nas/post-build-bootrd.sh"
BR2_ROOTFS_POST_IMAGE_SCRIPT="$(BR2_EXTERNAL_NVPLUS_NAS_PATH)/board/nvplus-nas/post-image-bootrd.sh"
BR2_PACKAGE_BUSYBOX_CONFIG_FRAGMENT_FILES="$(BR2_EXTERNAL_NVPLUS_NAS_PATH)/board/nvplus-nas/busybox.fragment"
BR2_PACKAGE_MDADM=y
BR2_PACKAGE_E2FSPROGS=y
BR2_TARGET_ROOTFS_CPIO=y
BR2_TARGET_ROOTFS_CPIO_GZIP=y
# BR2_TARGET_ROOTFS_TAR is not set
BR2_PACKAGE_HOST_UBOOT_TOOLS=y
BR2_JLEVEL=16
```

## recipe/configs/nvplus_nas_installer_defconfig
```kconfig
BR2_arm=y
BR2_arm926t=y
BR2_GLOBAL_PATCH_DIR="$(BR2_EXTERNAL_NVPLUS_NAS_PATH)/patches"
BR2_TOOLCHAIN_EXTERNAL=y
BR2_TOOLCHAIN_EXTERNAL_BOOTLIN=y
BR2_TOOLCHAIN_EXTERNAL_BOOTLIN_ARMV5_EABI_MUSL_STABLE=y
BR2_TARGET_GENERIC_HOSTNAME="nvplus-installer"
BR2_TARGET_GENERIC_ISSUE="ReadyNAS NV+ v2 installer / rescue (RAM only)"
BR2_TARGET_GENERIC_GETTY_PORT="ttyS0"
BR2_TARGET_GENERIC_GETTY_BAUDRATE_115200=y
BR2_SYSTEM_DHCP=""
BR2_ROOTFS_OVERLAY="$(BR2_EXTERNAL_NVPLUS_NAS_PATH)/board/nvplus-nas/overlay-installer"
BR2_ROOTFS_POST_BUILD_SCRIPT="$(BR2_EXTERNAL_NVPLUS_NAS_PATH)/board/nvplus-nas/post-build-installer.sh"
BR2_ROOTFS_POST_IMAGE_SCRIPT="$(BR2_EXTERNAL_NVPLUS_NAS_PATH)/board/nvplus-nas/post-image-installer.sh"
BR2_LINUX_KERNEL=y
BR2_LINUX_KERNEL_CUSTOM_VERSION=y
BR2_LINUX_KERNEL_CUSTOM_VERSION_VALUE="6.12.115"
BR2_LINUX_KERNEL_DEFCONFIG="mvebu_v5"
BR2_LINUX_KERNEL_CONFIG_FRAGMENT_FILES="$(BR2_EXTERNAL_NVPLUS_NAS_PATH)/board/nvplus-nas/linux-nas.fragment"
BR2_LINUX_KERNEL_XZ=y
BR2_LINUX_KERNEL_APPENDED_ZIMAGE=y
BR2_LINUX_KERNEL_DTS_SUPPORT=y
BR2_LINUX_KERNEL_INTREE_DTS_NAME="marvell/kirkwood-netgear_readynas_nv+_v2"
BR2_PACKAGE_BUSYBOX_CONFIG_FRAGMENT_FILES="$(BR2_EXTERNAL_NVPLUS_NAS_PATH)/board/nvplus-nas/busybox.fragment"
BR2_PACKAGE_MDADM=y
BR2_PACKAGE_E2FSPROGS=y
BR2_PACKAGE_UTIL_LINUX=y
BR2_PACKAGE_UTIL_LINUX_BINARIES=y
BR2_PACKAGE_UTIL_LINUX_WIPEFS=y
BR2_PACKAGE_MTD=y
BR2_PACKAGE_MTD_FLASH_ERASE=y
BR2_PACKAGE_MTD_NANDDUMP=y
BR2_PACKAGE_MTD_NANDWRITE=y
BR2_PACKAGE_UBOOT_TOOLS=y
BR2_PACKAGE_UBOOT_TOOLS_MKIMAGE=y
BR2_PACKAGE_SMARTMONTOOLS=y
BR2_PACKAGE_XZ=y
BR2_PACKAGE_BUSYBOX_SHOW_OTHERS=y
BR2_PACKAGE_TAR=y
BR2_PACKAGE_ETHTOOL=y
BR2_PACKAGE_I2C_TOOLS=y
BR2_INSTALL_LIBSTDCPP=y
BR2_TARGET_ROOTFS_CPIO=y
BR2_TARGET_ROOTFS_CPIO_GZIP=y
# BR2_TARGET_ROOTFS_TAR is not set
BR2_PACKAGE_HOST_UBOOT_TOOLS=y
BR2_JLEVEL=16
```
